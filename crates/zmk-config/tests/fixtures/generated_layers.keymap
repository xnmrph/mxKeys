// Fixture: the whole keymap is generated by helper macros, partly from another file.
#include <behaviors.dtsi>
#include <zmk-helpers/helper.h>
#include "zmk-helpers/key-labels/36.h"

#define BASE 0
#define NAV 1

ZMK_LAYER(base,
    &kp Q &kp W &kp E &kp R &kp T    &kp Y &kp U &kp I &kp O &kp P
)
ZMK_LAYER(nav, &trans)

#include "shared.keymap"
